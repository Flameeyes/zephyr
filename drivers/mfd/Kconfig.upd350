## drivers/mfd/Kconfig.upd350
```kconfig
# Copyright (c) 2023, Meta Platforms, Inc. and its affiliates.
# SPDX -License-Identifier: Apache-2.0

config MFD_UPD350
	bool "Microchip UPD350 multi-function device driver"
	depends on GPIO
	help
	  Enable the Microchip UPD350 PMIC multi-function device driver

config MFD_UPD350_SPI
	bool "Enable SPI transport for UDP350 (B/D)"
	default y
	depends on DT_HAS_MICROCHIP_UPD350_ENABLED && SPI
	select MFD_UPD350

if MFD_UPD350_SPI

config MFD_UPD350_SPI_INIT_PRIORITY
	int "Init priority"
	default 75
	help
	  Device driver initialization priority.

endif #MFD_UPD350_SPI
```

## drivers/usb_c/tcpc/Kconfig.tcpc_upd350
```kconfig
# Copyright (c) 2023, Meta Platforms, Inc. and its affiliates.
# SPDX-License-Identifier: Apache-2.0

config USBC_TCPC_UPD350
	bool "USB-C TCPC device controller driver for UPD350"
	default y
	depends on DT_HAS_MICROCHIP_UPD350_TCPC_ENABLED

if USBC_TCPC_UPD350

config USBC_TCPC_UPD350_INIT_PRIORITY
	int "Init priority"
	default 80
	help
	  Device driver initialization priority.

endif #USBC_TCPC_UPD350
```

## dts/bindings/mfd/microchip,upd350.yaml
```yaml
# Copyright (c) 2023, Meta Platforms, Inc. and its affiliates.
# SPDX-License-Identifier: Apache-2.0

description: |
  SPI-connected UPD350 USB Power Delivery 3.0 Port Controller.

compatible: "microchip,upd350"

include: [spi-device.yaml]

properties:
  reset-gpios:
    type: phandle-array
    description: |
        GPIO connected to the controller RESET pin. This pin is active-low.
```

## dts/bindings/usb-c/microchip,upd350_tcpc.yaml
```yaml
# Copyright (c) 2023, Meta Platforms, Inc. and its affiliates.
# SPDX-License-Identifier: Apache-2.0

description: |
  TCPC driver for UPD350.

compatible: "microchip,upd350_tcpc"
```
